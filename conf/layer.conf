## conf/layer.conf
```bitbake
# We have a conf and classes directory, append to BBPATH
BBPATH .= ":${LAYERDIR}"

# We have a recipes- directory, add to BBFILES
BBFILES += "${LAYERDIR}/recipes-*/*/*.bb ${LAYERDIR}/recipes*/*/*.bbappend"

BBFILE_COLLECTIONS += "ineltek"
BBFILE_PATTERN_ineltek := "^${LAYERDIR}/"
BBFILE_PRIORITY_ineltek = "12"

BBFILES += "${@' '.join('${LAYERDIR}/%s/recipes*/*/*.bbappend' % layer \
               for layer in BBFILE_COLLECTIONS.split())}"
BBFILES += "${@' '.join('${LAYERDIR}/%s/recipes*/*/*.bb' % layer \
               for layer in BBFILE_COLLECTIONS.split())}"

LAYERSERIES_COMPAT_ineltek = "thud warrior zeus dunfell"
VIRTUAL-RUNTIME_alsa-state = ""
```

## conf/machine/eink-extcon-demo.conf
```bitbake
#@TYPE: Machine
#@Name: Ineltek E Ink ExtCon Demo Board
#@DESCRIPTION: Machine configuration for Ineltek's E Ink SAMAD27-SOM1 evaluation board

require conf/machine/include/sama5d2.inc

# Build Options
MACHINE_FEATURES = "apm alsa ext2 ext3 usbhost usbgadget touchscreen"

# Sets the Root Filesystem size for an 8GB microSD card
#IMAGE_ROOTFS_SIZE = "5730000"
# Sets the Root Filesystem size for a 16GB microSD card
IMAGE_ROOTFS_SIZE = "11815000"

# Custom Deply Directory - where to place final binaries for programming
CUSTOM_DEPLOY_DIR = "~/extcon/program"

# U-Boot Config - environment variables in QSPI flash
UBOOT_IMG_ADDRESS = "0x10000"
UBOOT_IMG_SIZE = "0xA0000"

UBOOT_ENV_ADDRESS = "0x8000"
UBOOT_ENV_SIZE = "0x2000"

# DTB Name - check recipes-kernel/linux/files for source
KERNEL_DEVICETREE = "eink_extcon_demo.dtb"

# AT91Bootstrap Config - load to QSPI flash
AT91BOOTSTRAP_MACHINE = "sama5d27_som1_ek"
AT91BOOTSTRAP_LOAD = "qspiboot-uboot" 
AT91BOOTSTRAP_CONFIG = "sama5d27_som1_ekqspi_uboot"

# Root Filesystem
do_image_wic[depends] += "u-boot-at91:do_deploy"
IMAGE_FSTYPES += " wic wic.bmap"
# Sets the partition(s) of the root filesystem image
WKS_FILE = "sdimage-rootfs.wks"
```

## conf/machine/eink_extcon_demo.conf
```bitbake
#@TYPE: Machine
#@Name: Ineltek E Ink ExtCon Demo Board
#@DESCRIPTION: Machine configuration for Ineltek's E Ink SAMAD27-SOM1 evaluation board

require ../../../meta-atmel/conf/machine/include/sama5d2.inc

MACHINE_FEATURES = "apm alsa ext2 ext3 usbhost usbgadget touchscreen"
KERNEL_DEVICETREE = "eink_extcon_demo.dtb"

do_image_wic[depends] += "u-boot-at91:do_deploy"
IMAGE_FSTYPES += " tar.gz wic"
WKS_FILE = "sdimage-bootpart.wks"

IMAGE_BOOT_FILES = "BOOT.BIN u-boot.bin uboot.env sama5d27_som1_ek.itb \
                    "

#U-Boot Config - environment variables in QSPI flash
UBOOT_IMG_ADDRESS = "0x10000"
UBOOT_IMG_SIZE = "0xA0000"

UBOOT_ENV_ADDRESS = "0x8000"
UBOOT_ENV_SIZE = "0x2000"
```
